#include "main.h"
#include "stm32f10x.h"  

/**********************************************************************************************************
延时变量参数
**********************************************************************************************************/
unsigned int TimingDelay = 0;

/**********************************************************************************************************
函数名称：延时初始化
输入参数：无
输出参数：无
**********************************************************************************************************/
void Delay_Init(void)
{
                // Device header
    if (SysTick_Config(SystemCoreClock / 1000))
    {
        /* Capture error */
        while (1);
    }
}

/**********************************************************************************************************
函数名称：ms延时函数
输入参数：时间
输出参数：无
**********************************************************************************************************/
void Delay_ms(unsigned int time)
{
    TimingDelay = time;
    while(TimingDelay);
}

/**********************************************************************************************************
函数名称：us延时函数，最小延时为1us
输入参数：时间
输出参数：无
**********************************************************************************************************/
void Delay_us(unsigned int time)
{  
   unsigned short i=0; 
    
   while(time--)
   {
      i = 8;  
      while(i--) ;    
   }
}

/**********************************************************************************************************
函数名称：延时递减函数
输入参数：无
输出参数：无
**********************************************************************************************************/
void TimingDelay_Decrement(void)
{
    if (TimingDelay != 0x00)
    {
        TimingDelay--;
    }
}
